## Kconfig
```kconfig
#
# For a description of the syntax of this configuration file,
# see Documentation/kbuild/kconfig-language.txt.
#
mainmenu "Linux/$ARCH $KERNELVERSION Kernel Configuration"

config SRCARCH
	string
	option env="SRCARCH"

#Required for backported drivers to identify the needed helper functions
config KERNEL_3_4
	bool
	default y

source "arch/$SRCARCH/Kconfig"
source "backports/Kconfig"
```

## backports/Kconfig
```kconfig
config BACKPORT_INTEGRATE
	bool
	def_bool y

config BACKPORT_DIR
	string
	default "backports/"

config BACKPORT_VERSION
	string
	default "v5.8-1-1-ge3787e79"

config BACKPORT_KERNEL_VERSION
	string
	default "v5.8.18-0-gab435ce49bd1"

config BACKPORT_KERNEL_NAME
	string
	default "Linux"

menuconfig BACKPORT_LINUX
	bool "Backport Linux v5.8.18-0-gab435ce49bd1 (backports v5.8-1-1-ge3787e79)"
	default n
	---help---
	  Enabling this will let give you the opportunity to use features and
	  drivers backported from Linux v5.8.18-0-gab435ce49bd1
	  on the kernel your are using. This is experimental and you should
	  say no unless you'd like to help test things or want to help debug
	  this should we run into any issues.

if BACKPORT_LINUX

source "$BACKPORT_DIR/versions/Kconfig"
source "$BACKPORT_DIR/sources/Kconfig"
# source "$BACKPORT_DIR/local/Kconfig"

endif # BACKPORT_LINUX
```

## backports/drivers/net/wireless/ath/ath11k/Kconfig
```kconfig
# SPDX-License-Identifier: BSD-3-Clause-Clear
config BACKPORT_ATH11K
	tristate "Qualcomm Technologies 802.11ax chipset support"
	depends on !ATH11K
	depends on BACKPORT_MAC80211 && HAS_DMA
	depends on REMOTEPROC
	depends on CRYPTO_MICHAEL_MIC
	depends on ARCH_QCOM || COMPILE_TEST
	select BACKPORT_ATH_COMMON
	select QCOM_QMI_HELPERS
	help
	  This module adds support for Qualcomm Technologies 802.11ax family of
	  chipsets.

	  If you choose to build a module, it'll be called ath11k.

config BACKPORT_ATH11K_DEBUG
	bool "QCA ath11k debugging"
	depends on !ATH11K_DEBUG
	depends on BACKPORT_ATH11K
	help
	  Enables debug support

	  If unsure, say Y to make it easier to debug problems.

config BACKPORT_ATH11K_DEBUGFS
	bool "QCA ath11k debugfs support"
	depends on !ATH11K_DEBUGFS
	depends on ATH11K && DEBUG_FS && BACKPORT_MAC80211_DEBUGFS
	help
	  Enable ath11k debugfs support

	  If unsure, say Y to make it easier to debug problems.

config BACKPORT_ATH11K_TRACING
	bool "ath11k tracing support"
	depends on !ATH11K_TRACING
	depends on BACKPORT_ATH11K && EVENT_TRACING
	help
	  Select this to use ath11k tracing infrastructure.
```

## backports/drivers/net/wireless/cnss_genl/Kconfig
```kconfig
config BACKPORT_CNSS_GENL
	tristate "CNSS Generic Netlink Socket Driver"
	depends on !CNSS_GENL
	default y
	help
	  This module creates generic netlink family "CLD80211". This can be
	  used by cld driver and userspace utilities to communicate over
	  netlink sockets. This module creates different multicast groups to
	  facilitate the same.
```

## backports/versions/Kconfig
```kconfig
config BACKPORT_KERNEL_3_5
    def_bool y
config BACKPORT_KERNEL_3_6
    def_bool y
config BACKPORT_KERNEL_3_7
    def_bool y
config BACKPORT_KERNEL_3_8
    def_bool y
config BACKPORT_KERNEL_3_9
    def_bool y
config BACKPORT_KERNEL_3_10
    def_bool y
config BACKPORT_KERNEL_3_11
    def_bool y
config BACKPORT_KERNEL_3_12
    def_bool y
config BACKPORT_KERNEL_3_13
    def_bool y
config BACKPORT_KERNEL_3_14
    def_bool y
config BACKPORT_KERNEL_3_15
    def_bool y
config BACKPORT_KERNEL_3_16
    def_bool y
config BACKPORT_KERNEL_3_17
    def_bool y
config BACKPORT_KERNEL_3_18
    def_bool y
config BACKPORT_KERNEL_3_19
    def_bool y

#bpversion doesn't jump to the next main version when generating this file, so let's add that manually

config BACKPORT_KERNEL_4_0
    def_bool y
config BACKPORT_KERNEL_4_1
    def_bool y
config BACKPORT_KERNEL_4_2
    def_bool y
config BACKPORT_KERNEL_4_3
    def_bool y
config BACKPORT_KERNEL_4_4
    def_bool y
config BACKPORT_KERNEL_4_5
    def_bool y
config BACKPORT_KERNEL_4_6
    def_bool y
config BACKPORT_KERNEL_4_7
    def_bool y
config BACKPORT_KERNEL_4_8
    def_bool y

config BACKPORT_KERNEL_4_10
    def_bool y

config BACKPORT_KERNEL_4_18
    def_bool y

config BACKPORT_KERNEL_5_2
    def_bool y

config BACKPORT_KERNEL_5_5
    def_bool y
```
